/**
 * @cliArgs --device "MSPM0G350X" --part "Default" --package "LQFP-64(PM)" --product "mspm0_sdk@2.10.00.04"
 * @versions {"tool":"1.26.2+4477"}
 */

/**
 * Import the modules used in this configuration.
 */
const GPIO  = scripting.addModule("/ti/driverlib/GPIO", {}, false);
const GPIO1 = GPIO.addInstance();
const GPIO2 = GPIO.addInstance();
const GPIO3 = GPIO.addInstance();
const I2C   = scripting.addModule("/ti/driverlib/I2C", {}, false);
const I2C1  = I2C.addInstance();

/**
 * Write custom configuration values to the imported modules.
 */
GPIO1.$name                          = "GPIO_LEDS";
GPIO1.associatedPins.create(3);
GPIO1.associatedPins[0].$name        = "USER_LED_1";
GPIO1.associatedPins[0].assignedPort = "PORTA";
GPIO1.associatedPins[0].assignedPin  = "12";
GPIO1.associatedPins[1].$name        = "USER_LED_2";
GPIO1.associatedPins[1].assignedPort = "PORTA";
GPIO1.associatedPins[1].assignedPin  = "17";
GPIO1.associatedPins[2].$name        = "USER_LED_3";
GPIO1.associatedPins[2].assignedPort = "PORTA";
GPIO1.associatedPins[2].assignedPin  = "18";

const Board = scripting.addModule("/ti/driverlib/Board", {}, false);

GPIO2.$name                              = "GPIO_BUTTONS";
GPIO2.port                               = "PORTA";
GPIO2.associatedPins.create(3);
GPIO2.associatedPins[0].$name            = "GENERATE";
GPIO2.associatedPins[0].direction        = "INPUT";
GPIO2.associatedPins[0].assignedPin      = "5";
GPIO2.associatedPins[0].internalResistor = "PULL_UP";
GPIO2.associatedPins[1].$name            = "TEMP";
GPIO2.associatedPins[1].direction        = "INPUT";
GPIO2.associatedPins[1].assignedPin      = "7";
GPIO2.associatedPins[1].internalResistor = "PULL_UP";
GPIO2.associatedPins[2].$name            = "SEED";
GPIO2.associatedPins[2].direction        = "INPUT";
GPIO2.associatedPins[2].assignedPin      = "8";
GPIO2.associatedPins[2].internalResistor = "PULL_UP";

GPIO3.$name                          = "GPIO_BUZZER";
GPIO3.port                           = "PORTA";
GPIO3.associatedPins[0].$name        = "BUZZER";
GPIO3.associatedPins[0].direction    = "OUTPUT";
GPIO3.associatedPins[0].assignedPin  = "22";
GPIO3.associatedPins[0].initialValue = "CLEARED";

I2C1.$name                                   = "I2C_0";
I2C1.basicEnableController                   = true;
I2C1.peripheral.sdaPin.$assignAllowConflicts = "PA0";
I2C1.peripheral.sclPin.$assign               = "PA1";
I2C1.sdaPinConfig.$name                      = "ti_driverlib_gpio_GPIOPinGeneric2";
I2C1.sdaPinConfig.enableConfig               = true;
I2C1.sclPinConfig.$name                      = "ti_driverlib_gpio_GPIOPinGeneric3";
I2C1.sclPinConfig.enableConfig               = true;

const SYSCTL                 = scripting.addModule("/ti/driverlib/SYSCTL", {}, false);
SYSCTL.powerPolicy           = "STANDBY0";
SYSCTL.forceDefaultClkConfig = true;
SYSCTL.clockTreeEn           = true;

/**
 * Pinmux solution for unlocked pins/peripherals. This ensures that minor changes to the automatic solver in a future
 * version of the tool will not impact the pinmux you originally saw.  These lines can be completely deleted in order to
 * re-solve from scratch.
 */
GPIO1.associatedPins[0].pin.$suggestSolution = "PA12";
GPIO1.associatedPins[1].pin.$suggestSolution = "PA17";
GPIO1.associatedPins[2].pin.$suggestSolution = "PA18";
Board.peripheral.$suggestSolution            = "DEBUGSS";
Board.peripheral.swclkPin.$suggestSolution   = "PA20";
Board.peripheral.swdioPin.$suggestSolution   = "PA19";
GPIO2.associatedPins[0].pin.$suggestSolution = "PA5";
GPIO2.associatedPins[1].pin.$suggestSolution = "PA7";
GPIO2.associatedPins[2].pin.$suggestSolution = "PA8";
GPIO3.associatedPins[0].pin.$suggestSolution = "PA22";
I2C1.peripheral.$suggestSolution             = "I2C0";
